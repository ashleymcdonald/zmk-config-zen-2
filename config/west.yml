## config/west.yml
```yaml
manifest:
  remotes:
    - name: caksoylar
      url-base: https://github.com/caksoylar
#    - name: zmkfirmware
#      url-base: https://github.com/zmkfirmware
  projects:
    - name: zmk
      #remote: zmkfirmware
      #revision: main
      remote: caksoylar
      revision: caksoylar/zen-v2  # custom branch name
      import: app/west.yml
  self:
    path: config
```
